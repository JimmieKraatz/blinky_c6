## components/blinky/Kconfig
```kconfig
menu "Blinky"

    config BLINKY_LED_GPIO
        int "LED GPIO"
        default 14
        help
            GPIO used for the LED PWM output (active-low).
            Ensure this pin supports LEDC output on your target.

    config BLINKY_BTN_GPIO
        int "Button GPIO"
        default 9
        help
            GPIO used for the button input.
            Configure this to match your board's button wiring.

    config BLINKY_BTN_ACTIVE_LOW
        bool "Button active-low"
        default y
        help
            Enable if the button pulls the GPIO low when pressed.

    config BLINKY_POLL_MS
        int "Button/LED poll interval (ms)"
        default 10
        help
            Poll interval for the LED state machine.
            Smaller values increase responsiveness but cost more CPU.

    config BLINKY_DEBOUNCE_COUNT
        int "Button debounce count"
        default 3
        help
            Number of consecutive samples required to change button state.
            Effective debounce time is POLL_MS * DEBOUNCE_COUNT.

    config BLINKY_LONG_PRESS_MS
        int "Long-press duration (ms)"
        default 3000
        help
            Time the button must be held to trigger a long-press event.

    config BLINKY_WAVE_PERIOD_MS
        int "Wave period (ms)"
        default 1000
        help
            Target period for one full waveform cycle.

    choice BLINKY_START_WAVE
        prompt "Startup waveform"
        default BLINKY_START_WAVE_SINE
        help
            Initial waveform used on boot.

        config BLINKY_START_WAVE_SQUARE
            bool "Square"
            help
                Square wave (hard on/off).

        config BLINKY_START_WAVE_SAW_UP
            bool "Saw up"
            help
                Sawtooth ramp from 0% to 100%.

        config BLINKY_START_WAVE_SAW_DOWN
            bool "Saw down"
            help
                Sawtooth ramp from 100% to 0%.

        config BLINKY_START_WAVE_TRIANGLE
            bool "Triangle"
            help
                Triangle ramp up then down.

        config BLINKY_START_WAVE_SINE
            bool "Sine"
            help
                Smooth sine wave based on a LUT.
    endchoice

    config BLINKY_SINE_STEPS_MAX
        int "Sine LUT max steps"
        default 256
        range 8 1024
        help
            Maximum LUT size used for the sine wave. The actual number of
            steps is derived from BLINKY_WAVE_PERIOD_MS / BLINKY_POLL_MS,
            clamped to a minimum of 8 and this maximum.
            Larger values use more memory but allow smoother long periods.

    config BLINKY_SAW_STEP_PCT
        int "Saw step size (%)"
        default 5
        range 1 20
        help
            Percent change per update for saw and triangle waves.
            Smaller values give smoother transitions but require more steps.

    config BLINKY_PWM_FREQ_HZ
        int "LED PWM frequency (Hz)"
        default 5000
        range 100 20000
        help
            LEDC PWM frequency for the LED output.
            Higher values reduce flicker but can reduce duty resolution.

    config BLINKY_BOOT_PATTERN
        bool "Show boot pattern"
        default y
        help
            Flash the LED N times at boot to indicate the startup waveform.

    config BLINKY_BOOT_PATTERN_MS
        int "Boot pattern on/off time (ms)"
        default 120
        depends on BLINKY_BOOT_PATTERN
        help
            Duration for each on/off pulse in the boot pattern.

    config BLINKY_LOG_INTENSITY
        bool "Log intensity updates"
        default y
        help
            Print LED intensity updates to the serial console while running.

endmenu
```

## components/blinky_idf/Kconfig
```kconfig
menu "Blinky"

    config BLINKY_LED_GPIO
        int "LED GPIO"
        default 14
        help
            GPIO used for the LED PWM output (active-low).
            Ensure this pin supports LEDC output on your target.

    config BLINKY_BTN_GPIO
        int "Button GPIO"
        default 9
        help
            GPIO used for the button input.
            Configure this to match your board's button wiring.

    config BLINKY_BTN_ACTIVE_LOW
        bool "Button active-low"
        default y
        help
            Enable if the button pulls the GPIO low when pressed.

    choice BLINKY_BTN_PULL_MODE
        prompt "Button internal pull"
        default BLINKY_BTN_PULL_UP
        help
            Internal pull resistor selection for the button input.

        config BLINKY_BTN_PULL_NONE
            bool "None"
            help
                No internal pull resistor.

        config BLINKY_BTN_PULL_UP
            bool "Pull-up"
            help
                Enable the internal pull-up resistor.

        config BLINKY_BTN_PULL_DOWN
            bool "Pull-down"
            help
                Enable the internal pull-down resistor.
    endchoice

    config BLINKY_PRODUCER_POLL_MS
        int "Producer poll interval (ms)"
        default 10
        help
            Poll interval for producer-side input sampling in the LED state machine.
            Smaller values increase responsiveness but cost more CPU.

    config BLINKY_MODEL_POLL_MS
        int "Model update interval (ms)"
        default 10
        help
            Core model cadence value passed to LED runtime/model config.
            Smaller values increase update granularity but can increase CPU usage.

    config BLINKY_DEBOUNCE_COUNT
        int "Button debounce count"
        default 3
        help
            Number of consecutive samples required to change button state.
            Effective debounce time is PRODUCER_POLL_MS * DEBOUNCE_COUNT.

    config BLINKY_LONG_PRESS_MS
        int "Long-press duration (ms)"
        default 3000
        help
            Time the button must be held to trigger a long-press event.

    config BLINKY_WAVE_PERIOD_MS
        int "Wave period (ms)"
        default 1000
        help
            Target period for one full waveform cycle.

    config BLINKY_SINE_STEPS_MAX
        int "Sine LUT max steps"
        default 256
        range 8 1024
        help
            Maximum LUT size used for the sine wave. The actual number of
            steps is derived from BLINKY_WAVE_PERIOD_MS / BLINKY_MODEL_POLL_MS,
            clamped to a minimum of 8 and this maximum.
            Larger values use more memory but allow smoother long periods.

    config BLINKY_SAW_STEP_PCT
        int "Saw step size (%)"
        default 5
        range 1 20
        help
            Percent change per update for saw and triangle waves.
            Smaller values give smoother transitions but require more steps.

    config BLINKY_PWM_FREQ_HZ
        int "LED PWM frequency (Hz)"
        default 5000
        range 100 20000
        help
            LEDC PWM frequency for the LED output.
            Higher values reduce flicker but can reduce duty resolution.

    config BLINKY_BOOT_PATTERN
        bool "Show boot pattern"
        default y
        help
            Flash the LED N times at boot to indicate the startup waveform.
            N is (wave index + 1): Square=1, Saw Up=2, Saw Down=3,
            Triangle=4, Sine=5.

    config BLINKY_BOOT_PATTERN_MS
        int "Boot pattern on/off time (ms)"
        default 120
        depends on BLINKY_BOOT_PATTERN
        help
            Duration for each on/off pulse in the boot pattern.

    config BLINKY_LOG_INTENSITY
        bool "Log intensity updates"
        default y
        help
            Print LED intensity updates to the serial console while running.

    choice BLINKY_LOG_MIN_LEVEL
        prompt "Minimum log level"
        default BLINKY_LOG_MIN_LEVEL_INFO
        help
            Minimum severity emitted by the ESP-IDF logging sink.
            Lower verbosity reduces console load.

        config BLINKY_LOG_MIN_LEVEL_ERROR
            bool "Error"
            help
                Emit only error-level logs.

        config BLINKY_LOG_MIN_LEVEL_WARN
            bool "Warn"
            help
                Emit warn and error logs.

        config BLINKY_LOG_MIN_LEVEL_INFO
            bool "Info"
            help
                Emit info, warn, and error logs.

        config BLINKY_LOG_MIN_LEVEL_DEBUG
            bool "Debug"
            help
                Emit debug, info, warn, and error logs.
    endchoice

endmenu
```
